## meta-iguana/conf/layer.conf
```bitbake
# Tenemos un directorio de clases y conf, agregar a BBPATH
BBPATH .= ":${LAYERDIR}"

# Tenemos recetas- * directorios, agregar a BBFILES
BBFILES += "${LAYERDIR}/recipes-*/*.bb \
	${LAYERDIR}/recipes-*/*/*.bbappend "

BBFILE_COLLECTIONS += "iguana"
BBFILE_PATTERN_iguana = "^${LAYERDIR}/"
BBFILE_PRIORITY_iguana = "6"
```
